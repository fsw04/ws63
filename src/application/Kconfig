## src/application/Kconfig
```kconfig
#===============================================================================
# @brief    Kconfig file.
# Copyright (c) HiSilicon (Shanghai) Technologies Co., Ltd. 2023-2023. All rights reserved.
#===============================================================================

config SAMPLE_ENABLE
    bool
    prompt "Enable Sample."
    default n
    help
        This option means support Samples.

if SAMPLE_ENABLE
osource "application/samples/Kconfig"
endif

config WS63_ENABLE
    bool
    prompt "Enable WS63."
    default n

if WS63_ENABLE
osource "application/ws63/Kconfig"
endif
```

## src/application/samples/radar/Kconfig
```kconfig
#===============================================================================
# @brief    Kconfig file.
# Copyright (c) HiSilicon (Shanghai) Technologies Co., Ltd. 2023-2023. All rights reserved.
#===============================================================================

config SUPPORT_RADAR_STA_SAMPLE
    bool "Support RADAR STA Sample"

config SUPPORT_RADAR_SOFTAP_SAMPLE
    bool "Support RADAR SoftAP Sample."

config SUPPORT_RADAR_WIRELESS_SAMPLE
    bool "Support RADAR WIRELESS Sample"

config SUPPORT_RADAR_SLP_SAMPLE
    bool "Support RADAR SLP Sample"

config SUPPORT_RADAR_SLP_WIRELESS_SAMPLE
    bool "Support RADAR SLP WIRELESS Sample"

    if SUPPORT_RADAR_SLP_WIRELESS_SAMPLE
        config PC_OUT_NUM
            int
            prompt "cfg PC_OUT_NUM"
            range 30 60
            default 48

        config RADAR_ANT_PAIR_NUM
            int
            prompt "cfg RADAR_ANT_PAIR_NUM"
            range 1 4
            default 4
    endif
```

## src/application/samples/wifi/sta_sample/Kconfig
```kconfig
#===============================================================================
# @brief    Kconfig file.
# Copyright (c) HiSilicon (Shanghai) Technologies Co., Ltd. 2025-2025. All rights reserved.
#===============================================================================
config SAMPLE_SUPPORT_MQTT
    bool
    prompt "Support WIFI MQTT Sample"
    depends on SAMPLE_SUPPORT_STA_SAMPLE
    default n
    help
        This option means support MQTT sample depends on sta sample.
```
