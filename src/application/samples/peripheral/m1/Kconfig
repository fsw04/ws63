## src/application/samples/peripheral/m1/Kconfig
```kconfig
#===============================================================================
# @brief    M1 PN532 sample Kconfig file.
# Copyright (c) HiSilicon (Shanghai) Technologies Co., Ltd. 2023-2023. All rights reserved.
#===============================================================================
config M1_PN532_SOFT_I2C_SCL_PIN
    int
    prompt "Choose M1 PN532 software I2C SCL GPIO pin."
    depends on SAMPLE_SUPPORT_M1
    default 2

config M1_PN532_SOFT_I2C_SDA_PIN
    int
    prompt "Choose M1 PN532 software I2C SDA GPIO pin."
    depends on SAMPLE_SUPPORT_M1
    default 14

config M1_PN532_SOFT_I2C_DELAY_US
    int
    prompt "Choose M1 PN532 software I2C half clock delay in microseconds."
    depends on SAMPLE_SUPPORT_M1
    default 5

config M1_PN532_POLL_INTERVAL_MS
    int
    prompt "Set M1 card polling interval in milliseconds."
    depends on SAMPLE_SUPPORT_M1
    default 1000
```

## src/application/samples/peripheral/st7796s_ft6336u/Kconfig
```kconfig
#===============================================================================
# @brief    ST7796S LCD + FT6336U touch sample configuration
#===============================================================================
config ST7796S_SPI_BUS_ID
    int
    prompt "ST7796S SPI bus id."
    depends on SAMPLE_SUPPORT_ST7796S_FT6336U
    default 0

config ST7796S_SPI_MISO_PIN
    int
    prompt "ST7796S SPI MISO pin."
    depends on SAMPLE_SUPPORT_ST7796S_FT6336U
    default 11

config ST7796S_SPI_MOSI_PIN
    int
    prompt "ST7796S SPI MOSI pin."
    depends on SAMPLE_SUPPORT_ST7796S_FT6336U
    default 9

config ST7796S_SPI_CLK_PIN
    int
    prompt "ST7796S SPI clock pin."
    depends on SAMPLE_SUPPORT_ST7796S_FT6336U
    default 7

config ST7796S_SPI_CS_PIN
    int
    prompt "ST7796S SPI chip-select pin."
    depends on SAMPLE_SUPPORT_ST7796S_FT6336U
    default 10

config ST7796S_SPI_PIN_MODE
    int
    prompt "ST7796S SPI pin mode."
    depends on SAMPLE_SUPPORT_ST7796S_FT6336U
    default 3

config ST7796S_SPI_FREQUENCY_MHZ
    int
    prompt "ST7796S SPI frequency in MHz."
    depends on SAMPLE_SUPPORT_ST7796S_FT6336U
    default 32

config ST7796S_LCD_DC_PIN
    int
    prompt "ST7796S LCD DC/RS GPIO pin."
    depends on SAMPLE_SUPPORT_ST7796S_FT6336U
    default 6

config ST7796S_LCD_RESET_PIN
    int
    prompt "ST7796S LCD reset GPIO pin."
    depends on SAMPLE_SUPPORT_ST7796S_FT6336U
    default 3

config ST7796S_LCD_BL_PIN
    int
    prompt "ST7796S LCD backlight GPIO pin."
    depends on SAMPLE_SUPPORT_ST7796S_FT6336U
    default 8

config ST7796S_LCD_BL_ENABLE
    bool
    prompt "Drive ST7796S LCD backlight GPIO high."
    depends on SAMPLE_SUPPORT_ST7796S_FT6336U
    default y

config ST7796S_MADCTL
    hex
    prompt "ST7796S MADCTL value."
    depends on SAMPLE_SUPPORT_ST7796S_FT6336U
    default 0x48

config ST7796S_LVGL_RGB565_SWAPPED
    bool
    prompt "Use LVGL RGB565 swapped color format."
    depends on SAMPLE_SUPPORT_ST7796S_FT6336U
    default y
    help
        Enable this when the SPI panel expects RGB565 high byte first.

config FT6336U_I2C_BUS_ID
    int
    prompt "FT6336U I2C bus id."
    depends on SAMPLE_SUPPORT_ST7796S_FT6336U
    default 1

config FT6336U_I2C_SDA_PIN
    int
    prompt "FT6336U I2C SDA pin."
    depends on SAMPLE_SUPPORT_ST7796S_FT6336U
    default 15

config FT6336U_I2C_SCL_PIN
    int
    prompt "FT6336U I2C SCL pin."
    depends on SAMPLE_SUPPORT_ST7796S_FT6336U
    default 16

config FT6336U_I2C_PIN_MODE
    int
    prompt "FT6336U I2C pin mode."
    depends on SAMPLE_SUPPORT_ST7796S_FT6336U
    default 2

config FT6336U_RESET_PIN
    int
    prompt "FT6336U reset GPIO pin."
    depends on SAMPLE_SUPPORT_ST7796S_FT6336U
    default 12

config FT6336U_INT_PIN
    int
    prompt "FT6336U interrupt GPIO pin."
    depends on SAMPLE_SUPPORT_ST7796S_FT6336U
    default 2

config FT6336U_USE_INT_PIN
    bool
    prompt "Configure FT6336U INT pin as input."
    depends on SAMPLE_SUPPORT_ST7796S_FT6336U
    default n

config M1_PN532_SOFT_I2C_SCL_PIN
    int
    prompt "M1 PN532 software I2C SCL GPIO pin."
    depends on SAMPLE_SUPPORT_ST7796S_FT6336U
    default 13
    help
        Choose a GPIO that does not conflict with the LCD SPI pins or FT6336U touch pins.

config M1_PN532_SOFT_I2C_SDA_PIN
    int
    prompt "M1 PN532 software I2C SDA GPIO pin."
    depends on SAMPLE_SUPPORT_ST7796S_FT6336U
    default 14
    help
        Choose a GPIO that does not conflict with the LCD SPI pins or FT6336U touch pins.

config M1_PN532_SOFT_I2C_DELAY_US
    int
    prompt "M1 PN532 software I2C half clock delay in microseconds."
    depends on SAMPLE_SUPPORT_ST7796S_FT6336U
    default 5

config M1_PN532_POLL_INTERVAL_MS
    int
    prompt "M1 PN532 card polling interval in milliseconds."
    depends on SAMPLE_SUPPORT_ST7796S_FT6336U
    default 500
```

## src/application/ws63/Kconfig
```kconfig
#===============================================================================
# @brief    Kconfig file.
# Copyright (c) HiSilicon (Shanghai) Technologies Co., Ltd. 2023-2023. All rights reserved.
#===============================================================================

config ENABLE_WATCHCONTROL
    bool
    prompt "Enable watchcontrol."
    default n
    depends on WS63_ENABLE

if ENABLE_WATCHCONTROL
osource "application/ws63/watchcontrol/Kconfig"
endif

config ENABLE_WATCHDEVICE
    bool
    prompt "Enable watchdevice."
    default n
    depends on WS63_ENABLE

if ENABLE_WATCHDEVICE
osource "application/ws63/watchdevice/Kconfig"
endif

config ENABLE_MAX30102
    bool
    prompt "Enable max30102."
    default n
    depends on WS63_ENABLE

if ENABLE_MAX30102
osource "application/ws63/max30102/Kconfig"
endif

config ENABLE_HEART
    bool
    prompt "Enable heart."
    default n
    depends on WS63_ENABLE

if ENABLE_HEART
osource "application/ws63/heart/Kconfig"
endif

config SAMPLE_SUPPORT_SLE_LED
    bool
    prompt "Enable SLE_LED."
    default n
    depends on WS63_ENABLE

if SAMPLE_SUPPORT_SLE_LED
osource "application/ws63/sle_MAX30102/Kconfig"
endif

config ENABLE_LCD_TOUCH
    bool
    prompt "Enable LCD_TOUCH."
    default n
    depends on WS63_ENABLE

if ENABLE_LCD_TOUCH
osource "application/ws63/lcd_touch/Kconfig"
endif
```

## src/application/ws63/lcd_touch/Kconfig
```kconfig
#===============================================================================
# @brief    Kconfig file for ST7796 + FT6336 LCD Touch
#===============================================================================

config SPI_DI_PIN
    int
    prompt "SPI DI (MISO) PIN."
    depends on ENABLE_LCD_TOUCH
    default 11

config SPI_DO_PIN
    int
    prompt "SPI DO (MOSI) PIN."
    depends on ENABLE_LCD_TOUCH
    default 9

config SPI_CLK_PIN
    int
    prompt "SPI CLK PIN."
    depends on ENABLE_LCD_TOUCH
    default 7

config SPI_CS_PIN
    int
    prompt "SPI CS PIN."
    depends on ENABLE_LCD_TOUCH
    default 8

config SPI_MASTER_PIN_MODE
    int
    prompt "SPI MASTER PIN MODE."
    depends on ENABLE_LCD_TOUCH
    default 3

config SPI_RS_PIN
    int
    prompt "SPI DC/RS PIN."
    depends on ENABLE_LCD_TOUCH
    default 1

config SPI_RST_PIN
    int
    prompt "SPI RST PIN."
    depends on ENABLE_LCD_TOUCH
    default 14

config SPI_BLK_PIN
    int
    prompt "SPI Backlight PIN."
    depends on ENABLE_LCD_TOUCH
    default 12

config GPIO_PIN_MODE
    int
    prompt "GPIO PIN MODE."
    depends on ENABLE_LCD_TOUCH
    default 0

config TOUCH_SDA_PIN
    int
    prompt "Touch I2C SDA PIN."
    depends on ENABLE_LCD_TOUCH
    default 15

config TOUCH_SCL_PIN
    int
    prompt "Touch I2C SCL PIN."
    depends on ENABLE_LCD_TOUCH
    default 16

config TOUCH_RST_PIN
    int
    prompt "Touch RST PIN."
    depends on ENABLE_LCD_TOUCH
    default 13

config TOUCH_INT_PIN
    int
    prompt "Touch INT PIN."
    depends on ENABLE_LCD_TOUCH
    default 2
```

## vendor/ST7796_FT6336_LCD/demo/lcd_touch/Kconfig
```kconfig
#===============================================================================
# @brief    Kconfig file for ST7796 + FT6336 LCD Touch demo.
#===============================================================================

config SAMPLE_SUPPORT_LCD_TOUCH
    bool
    prompt "Support ST7796 + FT6336 LCD Touch."
    default y
    help
        This option means support ST7796 3.5inch SPI LCD + FT6336 capacitive touch.

config SAMPLE_SUPPORT_LCD
    bool
    default y
    depends on SAMPLE_SUPPORT_LCD_TOUCH

config SAMPLE_SUPPORT_TOUCH
    bool
    default y
    depends on SAMPLE_SUPPORT_LCD_TOUCH

# ==================== SPI LCD Pin Configuration ====================

config SPI_DI_PIN
    int
    prompt "SPI DI (MISO) PIN."
    depends on SAMPLE_SUPPORT_LCD
    default 11

config SPI_DO_PIN
    int
    prompt "SPI DO (MOSI) PIN."
    depends on SAMPLE_SUPPORT_LCD
    default 9

config SPI_CLK_PIN
    int
    prompt "SPI CLK PIN."
    depends on SAMPLE_SUPPORT_LCD
    default 7

config SPI_CS_PIN
    int
    prompt "SPI CS PIN."
    depends on SAMPLE_SUPPORT_LCD
    default 8

config SPI_MASTER_PIN_MODE
    int
    prompt "SPI MASTER PIN MODE."
    depends on SAMPLE_SUPPORT_LCD
    default 3

config SPI_RS_PIN
    int
    prompt "SPI DC/RS PIN."
    depends on SAMPLE_SUPPORT_LCD
    default 1

config SPI_RST_PIN
    int
    prompt "SPI RST PIN."
    depends on SAMPLE_SUPPORT_LCD
    default 14

config SPI_BLK_PIN
    int
    prompt "SPI Backlight PIN."
    depends on SAMPLE_SUPPORT_LCD
    default 12

config GPIO_PIN_MODE
    int
    prompt "GPIO PIN MODE."
    depends on SAMPLE_SUPPORT_LCD
    default 0

# ==================== FT6336 Touch Pin Configuration ====================

config TOUCH_SDA_PIN
    int
    prompt "Touch I2C SDA PIN."
    depends on SAMPLE_SUPPORT_TOUCH
    default 17

config TOUCH_SCL_PIN
    int
    prompt "Touch I2C SCL PIN."
    depends on SAMPLE_SUPPORT_TOUCH
    default 18

config TOUCH_RST_PIN
    int
    prompt "Touch RST PIN."
    depends on SAMPLE_SUPPORT_TOUCH
    default 13

config TOUCH_INT_PIN
    int
    prompt "Touch INT PIN."
    depends on SAMPLE_SUPPORT_TOUCH
    default 2
```
